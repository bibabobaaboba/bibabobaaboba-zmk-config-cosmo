#include "cosmo.dtsi"

&default_transform {
	col-offset = <6>;
};

&kscan0 {
	compatible = "zmk,kscan-gpio-matrix";

	col-gpios
		= <&pro_micro 19 (GPIO_ACTIVE_HIGH | GPIO_PULL_DOWN)> //col6
		, <&pro_micro 20 (GPIO_ACTIVE_HIGH | GPIO_PULL_DOWN)> //col7
		, <&pro_micro 10 (GPIO_ACTIVE_HIGH | GPIO_PULL_DOWN)> //col8
		, <&pro_micro 6 (GPIO_ACTIVE_HIGH | GPIO_PULL_DOWN)> //col9
		, <&pro_micro 7 (GPIO_ACTIVE_HIGH | GPIO_PULL_DOWN)> //col10
		, <&pro_micro 16 (GPIO_ACTIVE_HIGH | GPIO_PULL_DOWN)> //col11
		;

	row-gpios
		= <&pro_micro 4 GPIO_ACTIVE_HIGH> //row0
		, <&pro_micro 5 GPIO_ACTIVE_HIGH> //row1
		, <&pro_micro 18 GPIO_ACTIVE_HIGH> //row2
		, <&pro_micro 21 GPIO_ACTIVE_HIGH> //row3
		;
};
